## conf/layer.conf
```bitbake
# We have a conf and classes directory, add to BBPATH
BBPATH .= ":${LAYERDIR}"

# We have a recipes-* directories, add to BBFILES
BBFILES += "${LAYERDIR}/recipes-*/*/*.bb \
	${LAYERDIR}/recipes-*/*/*.bbappend"

BBFILE_COLLECTIONS += "acpi"
BBFILE_PATTERN_acpi = "^${LAYERDIR}/"
BBFILE_PRIORITY_acpi = "6"

LAYERDEPENDS_acpi = "intel"
```

## conf/machine/galileo-gen2.conf
```bitbake
#@TYPE: Machine
#@NAME: Galileo Gen 2
#@DESCRIPTION: Machine configuration for Intel Galileo Gen 2 systems

require conf/machine/include/acpi.inc
require conf/machine/include/meta-intel.inc
require conf/machine/include/intel-quark-common.inc
require conf/machine/include/intel-common-pkgarch.inc

MACHINE_FEATURES += "efi"
MACHINE_FEATURES += "intel-ucode"

SERIAL_CONSOLE = "115200 ttyS1"
APPEND += "rootwait console=ttyS1,115200"

# Include following sample devices with the image. These are found under
# recipes-bsp/acpi-tables/samples/${MACHINE}. You can override these
# with your own in your local.conf if needed.
ACPI_TABLES ?= "gpiomux-all.asl spidev.asl"
```

## conf/machine/galileo.conf
```bitbake
#@TYPE: Machine
#@NAME: Galileo
#@DESCRIPTION: Machine configuration for Intel Galileo systems

require conf/machine/include/acpi.inc
require conf/machine/intel-quark.conf

# Include following sample devices with the image. These are found under
# recipes-bsp/acpi-tables/samples/${MACHINE}. You can override these
# with your own in your local.conf if needed.
ACPI_TABLES ?= "gpiomux-i2c-spi-uart0.asl spidev.asl"
```

## conf/machine/include/acpi.inc
```bitbake
PREFERRED_PROVIDER_virtual/kernel ?= "linux-kernel"
# EFI capable systems do not require any special boot loader
#EFI_PROVIDER ?= ""

# Include ACPI ASL fragments with the initrd
EXTRA_IMAGEDEPENDS_append = " acpi-fragments"
INITRD_LIVE_prepend = "${DEPLOY_DIR_IMAGE}/acpi-fragments.cpio "

IMAGE_INSTALL_append = " acpidump"
```

## conf/machine/joule.conf
```bitbake
#@TYPE: Machine
#@NAME: Joule
#@DESCRIPTION: Machine configuration for Intel Joule systems

require conf/machine/include/acpi.inc
require conf/machine/include/meta-intel.inc
require conf/machine/include/intel-corei7-64-common.inc
require conf/machine/include/intel-common-pkgarch.inc

MACHINE_FEATURES += "pcbios efi"
MACHINE_FEATURES += "wifi"
MACHINE_FEATURES += "intel-ucode"

MACHINE_EXTRA_RRECOMMENDS += "linux-firmware"

# Include following sample devices with the image. These are found under
# recipes-bsp/acpi-tables/samples/${MACHINE}. You can override these
# with your own in your local.conf if needed.
ACPI_TABLES ?= "leds.asl spidev0.asl"

SERIAL_CONSOLE = "115200 ttyS2"
APPEND += "console=ttyS2,115200"
```

## conf/machine/minnowboard-max.conf
```bitbake
#@TYPE: Machine
#@NAME: Minnowboard MAX
#@DESCRIPTION: Machine configuration for Intel Minnowboard MAX systems

require conf/machine/include/acpi.inc
require conf/machine/include/meta-intel.inc
require conf/machine/include/intel-corei7-64-common.inc
require conf/machine/include/intel-common-pkgarch.inc

MACHINE_FEATURES += "pcbios efi"
MACHINE_FEATURES += "wifi"
MACHINE_FEATURES += "intel-ucode"

# Include following sample devices with the image. These are found under
# recipes-bsp/acpi-tables/samples/${MACHINE}. You can override these
# with your own in your local.conf if needed.
ACPI_TABLES ?= "spidev.asl"

SERIAL_CONSOLE = "115200 ttyS0"
APPEND += "console=ttyS0,115200"
```

## conf/machine/minnowboard.conf
```bitbake
#@TYPE: Machine
#@NAME: Minnowboard
#@DESCRIPTION: Machine configuration for Intel Minnowboard systems

require conf/machine/include/acpi.inc
require conf/machine/include/meta-intel.inc
require conf/machine/include/intel-core2-32-common.inc
require conf/machine/include/intel-common-pkgarch.inc

MACHINE_FEATURES += "pcbios efi"
MACHINE_FEATURES += "wifi"
MACHINE_FEATURES += "intel-ucode"

# Include following sample devices with the image. These are found under
# recipes-bsp/acpi-fragments/samples/${MACHINE}. You can override these
# with your own in your local.conf if needed.
ACPI_FRAGMENTS ?= "buttons.asl leds.asl"

SERIAL_CONSOLE = "115200 ttyPCH0"
APPEND += "console=ttyPCH0,115200"
```
